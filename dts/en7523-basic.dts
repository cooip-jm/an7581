#include <dt-bindings/interrupt-controller/irq.h>
#include <dt-bindings/interrupt-controller/arm-gic.h>
#include <dt-bindings/gpio/gpio.h>
#include <dt-bindings/leds/common.h>
#include <dt-bindings/input/input.h>

/dts-v1/;

#include "en7523-base.dtsi"

/*
 * During boot u-boot will detect actual board type and switch to proper dtb.
 * Old devices will not be touched, new devices will be initialized, so the
 * less devices you have in u-boot default dts -- the better.
 *
 * All Leds & buttons MUST be disabled.
 *
 * Minimal set of devices:
 *   [required]  serial console
 *   [required]  spi bus  (flash support)
 *   [required]  spi-nand (flash support)
 *   [required]  ethernet (update firmware)
 *   [optional]  gpio
 */

/ {
	model = "en75xx-arm";
	compatible = "econet,en7523";

	config {
		bootdelay = <2>;
	};
};

&voip {
	slic-power-mode = "none";	// disable VoIP
};
