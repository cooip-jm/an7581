#include <dt-bindings/interrupt-controller/irq.h>
#include <dt-bindings/interrupt-controller/arm-gic.h>
#include <dt-bindings/gpio/gpio.h>
#include <dt-bindings/leds/common.h>
#include <dt-bindings/input/input.h>

/dts-v1/;

#include "en7581-base.dtsi"

/ {
	model = "EN75xx GENERIC";
	compatible = "econet,en7581", "airoha,en7581";

	config {
		bootdelay = <2>;
	};
};

&voip {
	slic-power-mode = "none";
};
